## prj.conf
```kconfig
CONFIG_ISR_STACK_SIZE=2048
CONFIG_MAIN_STACK_SIZE=2048
CONFIG_COMMAND_STACK_SIZE=2048
# nothing here
```

## src/main.c
```c
#include <stdlib.h>
#include <stdint.h>
#include <stdbool.h>
#include <limits.h>

#ifdef CONFIG_ARCH
#include <zephyr.h>
#include <misc/printk.h>
#include "qsort.h"
#else
#include "adaptation.h"
#endif

#include "sqrt.h"

#include "main.h"

// -----------------------------------------------------------

#if DO_LOG_OUTPUT
#define LOG(...) printk(__VA_ARGS__)
#else
#define LOG(...)
#endif

#if DO_LOG_OUTPUT
#define OUTPUT(x, variable, format) printk(format, x)
#else
#define OUTPUT(x, variable, format) variable = x
#endif

#define OUTPUT_I(x, variable)  OUTPUT(x, variable, "%d ")
#define OUTPUT_IL(x, variable) OUTPUT(x, variable, "%lld ")
#define OUTPUT_F(x, variable)  OUTPUT(x, variable, "%f ")

// -----------------------------------------------------------

#define NUM_AXIS 3

typedef struct {
    int8_t v[NUM_AXIS];
} accel_t;

typedef struct {
    int32_t v[NUM_AXIS];
} result_i_t;

typedef struct {
    float v[NUM_AXIS];
} result_f_t;

// -----------------------------------------------------------

// the input data
#if CONTIKI_TARGET_Z1
// take only 7500 samples: 10000 or more are not supported by the compiler
const accel_t data[7500] =
#else
// take as many samples as provided
const accel_t data[] =
#endif
{
#ifdef FEATURE_TEST_INPUT
# include FEATURE_TEST_INPUT
#else
# include "../../data/00001-1.c"
#endif
};

// the total number of samples
#define NSAMPLES (sizeof(data) / sizeof(*data))

// -----------------------------------------------------------

typedef void (*feature_function)(void);

typedef struct {
    const char *name;
    feature_function f;
    int class;
} test_t;

// the result of the accel calculations is stored here
volatile result_i_t result_i;
volatile result_f_t result_f;

// -----------------------------------------------------------

#include "features-time-basic.c"
#include "features-time-median.c"
#include "features-time-advanced.c"

#ifndef CONTIKI_TARGET_Z1
// The msp430 compiler is not able to compile the FFT code
#include "features-frequency.c"
#endif

// -----------------------------------------------------------
void test(const test_t *t)
{
    s64_t start = k_uptime_get();
    int i;
    LOG("Start feature: %s\n", t->name);
    for (i = 0; i < NUM_REPETITIONS[t->class]; ++i) {
        t->f();
    }
    // print time needed
    s64_t delta = k_uptime_delta(&start);
#if 1
    printk("Feature: %s Time: %lu usec per %u samples\n",
            t->name,
            (long unsigned)(delta * 1000.0 / NUM_REPETITIONS[t->class]),
            (unsigned)NSAMPLES);
#else
    printk("Feature: %s Time: %lld ms (%d times)\n",
            t->name, delta, NUM_REPETITIONS[t->class]);
#endif
}

// -----------------------------------------------------------

void feature_memory_access(void)
{
    void *v;
    v = &v;
    uint8_t *x = v;
    uint8_t *end = x - 1000;
    volatile int c = 0;
    while (x >= end) {
        if(*x == 0xc1) {
            c++;
        }
        x--;
    }
//    printf("c=%d\n", c);
}

// -----------------------------------------------------------

const test_t tests[] =
{
//    { "memory access     ", feature_memory_access, VERY_FAST},

    // Time domain features
    { "mean (f)          ", feature_mean_f, MODERATE },
    { "mean (f, p)       ", feature_mean_periodic_f, MODERATE },
    { "mean (i)          ", feature_mean_i, VERY_FAST },
    { "mean (i, p)       ", feature_mean_periodic_i, VERY_FAST },
    { "quartile_25 (i)   ", feature_quartile_25, FAST },
    { "quartile_25 (i, p)", feature_quartile_25_periodic, FAST },
    { "median (i)        ", feature_median, FAST },
    { "median (i, p)     ", feature_median_periodic, FAST },
    { "quartile_75 (i)   ", feature_quartile_75, FAST },
    { "quartile_75 (i, p)", feature_quartile_75_periodic, FAST },
    { "quartiles (i, p)  ", feature_quartiles_periodic, FAST },
    { "min (i)           ", feature_min, VERY_FAST },
    { "min (i, p)        ", feature_min_periodic, VERY_FAST },
    { "max (i)           ", feature_max, VERY_FAST },
    { "max (i, p)        ", feature_max_periodic, VERY_FAST },
    { "variance (i)      ", feature_variance, FAST },
    { "variance (i, p)   ", feature_variance_periodic, FAST },
    { "std (f)           ", feature_std, MODERATE },
    { "std (f, p)        ", feature_std_periodic, MODERATE },
    { "magnitude^2 (i)   ", feature_magnitude_sq_i, VERY_FAST },
    { "magnitude (f)     ", feature_magnitude_f, MODERATE },
    { "0-crossings (i)   ", feature_zero_crossings, FAST },
    { "0-crossings (i, p)", feature_zero_crossings_periodic, FAST },
    { "entropy (f)       ", feature_entropy_f, MODERATE },
    { "entropy (f, p)    ", feature_entropy_periodic_f, MODERATE },
    { "histogram (i, p)  ", feature_histogram_periodic, FAST },

#ifndef CONTIKI_TARGET_Z1
    // Frequency domain features
    // All these features are periodic (calculated once per second)
    { "spectral density (i)     ", feature_spectral_density_i, MODERATE },
    { "spectral density (f)     ", feature_spectral_density_f, MODERATE },
    { "spectral maxima (i)      ", feature_spectral_maxima_i, MODERATE },
    { "spectral maxima (f)      ", feature_spectral_maxima_f, MODERATE },
    { "spectral centroid (f)    ", feature_spectral_centroid_f, MODERATE },
    { "spectral flux (f)        ", feature_spectral_flux_f, MODERATE },
    { "spectral entropy (f)     ", feature_spectral_entropy_f, MODERATE },
    { "spectral magn. area (f)  ", feature_spectral_ma_f, MODERATE },
    { "spectral magn. area^2 (i)", feature_spectral_ma_squared_i, MODERATE },
    { "spectral histogram (i)   ", feature_spectral_histogram_i, MODERATE },
    { "spectral histogram (f)   ", feature_spectral_histogram_f, MODERATE },
#endif // CONTIKI_TARGET_Z1
};

// -----------------------------------------------------------

void do_tests(void)
{
    int i;

    printk("Starting tests, ARCH=%s F_CPU=%d MHz\n",
           CONFIG_ARCH, (int)(CONFIG_SYS_CLOCK_HW_CYCLES_PER_SEC / 1000000));
    for (i = 0; i < sizeof(tests) / sizeof(*tests); ++i) {
        test(&tests[i]);
    }
    printk("Done!\n");
}

// -----------------------------------------------------------

#if CONTIKI

#include "dev/watchdog.h"

PROCESS(test_process, "Test process");
AUTOSTART_PROCESSES(&test_process);

PROCESS_THREAD(test_process, ev, data)
{
  PROCESS_BEGIN();

  printk("start\n");

#if CONTIKI_TARGET_NRF52DK
  // Enable the FPU bits in the Coprocessor Access Control Register
  SCB->CPACR |= (3UL << 20) | (3UL << 22);
  // Data Synchronization Barrier
  __DSB();
  // Instruction Synchronization Barrier
  __ISB();
#else // CONTIKI_TARGET_NRF52DK

  // Stop the watchdog (breaks the system on NRF52DK).
  // Note: this function is used as not all platforms define watchdog_stop()!
  watchdog_init();

#endif
 
  do_tests();

  PROCESS_END();
}

#else

int main(void)
{
    do_tests();
}

#endif

// -----------------------------------------------------------

// soft:
// Starting tests, ARCH=sphere F_CPU=48 MHz
// Feature: mean (f)           Time: 24000 usec per 15000 samples
// Feature: mean (f, p)        Time: 31000 usec per 15000 samples
// Feature: magnitude (f)      Time: 148000 usec per 15000 samples

// normal (sqrtf from arm libmath):
// Feature: mean (f)           Time: 24000 usec per 15000 samples
// Feature: mean (f, p)        Time: 31000 usec per 15000 samples
// Feature: magnitude (f)      Time: 125000 usec per 15000 samples

// __sqrtf (hardware)
```

## src/adaptation.h
```c
//
// This is a native (x86) adaptation layer for functinality normally provided by the Zephyr OS
//

#include <sys/time.h>
#include <stdio.h>
#include <stdio.h>
#include <math.h>

#define printk printf

typedef long long int s64_t;

#if CONTIKI_TARGET_SRF06_CC26XX || CONTIKI_TARGET_Z1 || CONTIKI_TARGET_ZOUL || CONTIKI_TARGET_NRF52DK
#define CONTIKI 1
#else
#define CONTIKI 0
#endif

#if CONTIKI
#include "contiki.h"

#define CONFIG_ARCH "sphere"
#define CONFIG_SYS_CLOCK_HW_CYCLES_PER_SEC (48u * 1000 * 1000)

static inline s64_t k_uptime_get(void)
{
    unsigned long t = clock_time();
    // convert to milliseconds
    return t * 1000 / CLOCK_SECOND;
}

static inline s64_t k_uptime_delta(s64_t *s)
{
    return k_uptime_get() - *s;
}

#define min(a, b) MIN(a, b)
#define max(a, b) MAX(a, b)

#else // CONTIKI

#include <memory.h>
#include <complex.h>

typedef float complex cplx;

static inline s64_t k_uptime_get(void)
{
    struct timeval tv;
    gettimeofday(&tv, NULL);

    return tv.tv_sec * 1000 + tv.tv_usec / 1000;
}

static inline s64_t k_uptime_delta(s64_t *s)
{
    return k_uptime_get() - *s;
}

#define min(a, b) ((a) < (b) ? (a) : (b))
#define max(a, b) ((a) > (b) ? (a) : (b))

#define CONFIG_ARCH "native"
#define CONFIG_SYS_CLOCK_HW_CYCLES_PER_SEC 1

// square root
//#define arm_sqrt_f32 sqrtf

#endif
```

## src/bitreverse.h
```c
//
// Reverse bits in a n-bit word: needed for the non-recursive implementation of FFT
//

#include "main.h"

#ifndef BITREV_H
#define BITREV_H

static const uint8_t bitrev_table_32[] = 
{
    0, 16,  8, 24,  4, 20, 12, 28,  2, 18, 10, 26,  6, 22, 14, 30, 
    1, 17,  9, 25,  5, 21, 13, 29,  3, 19, 11, 27,  7, 23, 15, 31,
};

static const uint8_t bitrev_table_64[] = 
{
    0, 32, 16, 48,  8, 40, 24, 56,  4, 36, 20, 52, 12, 44, 28, 60, 
    2, 34, 18, 50, 10, 42, 26, 58,  6, 38, 22, 54, 14, 46, 30, 62, 
    1, 33, 17, 49,  9, 41, 25, 57,  5, 37, 21, 53, 13, 45, 29, 61, 
    3, 35, 19, 51, 11, 43, 27, 59,  7, 39, 23, 55, 15, 47, 31, 63, 
};

static const uint8_t bitrev_table_128[] = 
{
    0,  64,  32,  96,  16,  80,  48, 112,   8,  72,  40, 104,  24,  88,  56, 120, 
    4,  68,  36, 100,  20,  84,  52, 116,  12,  76,  44, 108,  28,  92,  60, 124, 
    2,  66,  34,  98,  18,  82,  50, 114,  10,  74,  42, 106,  26,  90,  58, 122, 
    6,  70,  38, 102,  22,  86,  54, 118,  14,  78,  46, 110,  30,  94,  62, 126, 
    1,  65,  33,  97,  17,  81,  49, 113,   9,  73,  41, 105,  25,  89,  57, 121, 
    5,  69,  37, 101,  21,  85,  53, 117,  13,  77,  45, 109,  29,  93,  61, 125, 
    3,  67,  35,  99,  19,  83,  51, 115,  11,  75,  43, 107,  27,  91,  59, 123, 
    7,  71,  39, 103,  23,  87,  55, 119,  15,  79,  47, 111,  31,  95,  63, 127, 
};

static const uint8_t bitrev_table_256[] = 
{
    0, 128,  64, 192,  32, 160,  96, 224,  16, 144,  80, 208,  48, 176, 112, 240, 
    8, 136,  72, 200,  40, 168, 104, 232,  24, 152,  88, 216,  56, 184, 120, 248, 
    4, 132,  68, 196,  36, 164, 100, 228,  20, 148,  84, 212,  52, 180, 116, 244, 
    12, 140,  76, 204,  44, 172, 108, 236,  28, 156,  92, 220,  60, 188, 124, 252, 
    2, 130,  66, 194,  34, 162,  98, 226,  18, 146,  82, 210,  50, 178, 114, 242, 
    10, 138,  74, 202,  42, 170, 106, 234,  26, 154,  90, 218,  58, 186, 122, 250, 
    6, 134,  70, 198,  38, 166, 102, 230,  22, 150,  86, 214,  54, 182, 118, 246, 
    14, 142,  78, 206,  46, 174, 110, 238,  30, 158,  94, 222,  62, 190, 126, 254, 
    1, 129,  65, 193,  33, 161,  97, 225,  17, 145,  81, 209,  49, 177, 113, 241, 
    9, 137,  73, 201,  41, 169, 105, 233,  25, 153,  89, 217,  57, 185, 121, 249, 
    5, 133,  69, 197,  37, 165, 101, 229,  21, 149,  85, 213,  53, 181, 117, 245, 
    13, 141,  77, 205,  45, 173, 109, 237,  29, 157,  93, 221,  61, 189, 125, 253, 
    3, 131,  67, 195,  35, 163,  99, 227,  19, 147,  83, 211,  51, 179, 115, 243, 
    11, 139,  75, 203,  43, 171, 107, 235,  27, 155,  91, 219,  59, 187, 123, 251, 
    7, 135,  71, 199,  39, 167, 103, 231,  23, 151,  87, 215,  55, 183, 119, 247, 
    15, 143,  79, 207,  47, 175, 111, 239,  31, 159,  95, 223,  63, 191, 127, 255, 
};

#if FREQUENCY_FEATURE_WINDOW_SIZE == 32

static inline uint16_t bitrev(uint16_t j)
{
    return bitrev_table_32[j];
}

#elif FREQUENCY_FEATURE_WINDOW_SIZE == 64

static inline uint16_t bitrev(uint16_t j)
{
    return bitrev_table_64[j];
}

#elif FREQUENCY_FEATURE_WINDOW_SIZE == 128

static inline uint16_t bitrev(uint16_t j)
{
    return bitrev_table_128[j];
}

#elif FREQUENCY_FEATURE_WINDOW_SIZE == 256

static inline uint16_t bitrev(uint16_t j)
{
    return bitrev_table_256[j];
}

#else

/* slower, but a more generic algorithm */

static uint16_t bitrev(uint16_t j, uint16_t nbits)
{
  uint16_t k = 0;
  for (; nbits > 0; nbits--) {
    k = (k << 1) + (j & 1);
    j = j >> 1;
  }
  return k;
}

#endif

#endif // BITREV_H
```

## src/features-frequency.c
```c
// ------------------------------------------

// Integer FFT
#include "intfft.c"

// Floating point FFT
#include "fft.c"

// Logarithm function
#include "log.c"

//
// The FFT is not post-processed (reordered or normalized).
// Therefore the structure of the FFT result is this:
//
//    [DC] [F1] [F2] ... [FNQ-1] [FNQ] [-FNQ-1] ... [-F2] [-F1]
//      0    1   2   ...   N/2-1  N/2    N/2+1  ...  N-2   N-1
//
// where DC is the direct current, and FNQ is the Nyquist frequency.
// For real-valued signals [-F_i] = -[F_i],
// i.e. |[-F_i]| = |[F_i]|, so just half of the results is effectively useful.
//

// ------------------------------------------

// The following must hold: (#bins - 1) * (2 * divider) == FREQUENCY_FEATURE_WINDOW_SIZE
#define NUM_FREQUENCY_HISTOGRAM_BINS 9
#define FREQUENCY_HISTOGRAM_DIVIDER (FREQUENCY_FEATURE_WINDOW_SIZE / 16)

// ------------------------------------------

typedef void spectral_feature_function_f_t(float re[], float im[], int axis);
typedef void spectral_feature_function_i_t(int16_t re[], int16_t im[], int axis);

#define tlog2f(x) __ieee754_log2(x)

#if CONTIKI_TARGET_NRF52DK
// The `fabs` and `fabsf` functions are not defined for this target
float fabsf(float x)
{
    return x > 0 ? x : -x;
}
#endif

// ------------------------------------------

void spectral_feature_maxima_f(float re[], float im[], int axis)
{
    int j;
    // search for the maximal nonzero frequency, starting from the highest (offset N/2 + 1)
    // TODO: what to use as the epsilon here?
    float epsilon = 0.1;
    for (j = FREQUENCY_FEATURE_WINDOW_SIZE / 2 + 1; j >= 0; --j) {
        float msq = re[j] * re[j] + im[j] * im[j];
        if (fabsf(msq) > epsilon) {
            OUTPUT_F(msq, result_f.v[axis]);
            LOG("\n");
            break;
        }
    }
}

void spectral_feature_maxima_i(int16_t re[], int16_t im[], int axis)
{
    int j;
    // search for the maximal nonzero frequency, starting from the highest (offset N/2 + 1)
    for (j = FREQUENCY_FEATURE_WINDOW_SIZE / 2 + 1; j >= 0; --j) {
        uint32_t msq = (uint32_t)re[j] * re[j] + im[j] * im[j];
        if (msq != 0) {
            OUTPUT_I(msq, result_i.v[axis]);
            LOG("\n");
            break;
        }
    }
}

void spectral_feature_density_f(float re[], float im[], int axis)
{
    int j;
    for (j = 0; j <= FREQUENCY_FEATURE_WINDOW_SIZE / 2; ++j) {
        float msq = re[j] * re[j] + im[j] * im[j];
        OUTPUT_F(msq, result_f.v[axis]);
        LOG("\n");
    }
}

void spectral_feature_density_i(int16_t re[], int16_t im[], int axis)
{
    int j;
    for (j = 0; j <= FREQUENCY_FEATURE_WINDOW_SIZE / 2; ++j) {
        uint32_t msq = (uint32_t)re[j] * re[j] + im[j] * im[j];
        OUTPUT_I(msq, result_i.v[axis]);
        LOG("\n");
    }
}

// This discards the DC component (frequency == 0) and the negative frequencies.
// XXX: what if the DC component is the dominating one?
void spectral_feature_centroid_f(float re[], float im[], int axis)
{
    int j;
    float numerator = 0, denominator = 0;
    float normalization_coefficient = 1.0 / (FREQUENCY_FEATURE_WINDOW_SIZE * FREQUENCY_FEATURE_WINDOW_SIZE);
    for (j = 1; j <= FREQUENCY_FEATURE_WINDOW_SIZE / 2; ++j) {
        // `m` is the magnitude
        float m = tsqrtf(normalization_coefficient * (re[j] * re[j] + im[j] * im[j]));
        numerator += j * m;
        denominator += m;
    }
    OUTPUT_F(numerator / denominator, result_f.v[axis]);
    LOG("\n");
}

// XXX: not sure this is the correct definition of entropy of a complex signal
void spectral_feature_entropy_f(float re[], float im[], int axis)
{
    int j;
    float entropy = 0;
    float squared_sum = 0;
    float msq[FREQUENCY_FEATURE_WINDOW_SIZE];
    float normalization_coefficient = 1.0 / (FREQUENCY_FEATURE_WINDOW_SIZE * FREQUENCY_FEATURE_WINDOW_SIZE);
    for (j = 0; j < FREQUENCY_FEATURE_WINDOW_SIZE; ++j) {
        msq[j] = normalization_coefficient * (re[j] * re[j] + im[j] * im[j]); // calculate the squared module |x|^2
        squared_sum += msq[j];
    }
    for (j = 0; j < FREQUENCY_FEATURE_WINDOW_SIZE; ++j) {
        float q = msq[j] / squared_sum;
        if (q) {
            entropy += q * tlog2f(q);
        }
    }
    entropy = -entropy;
    OUTPUT_F(entropy, result_f.v[axis]);
    LOG("\n");
}

void spectral_feature_histogram_i(int16_t re[], int16_t im[], int axis)
{
    int i;
    uint32_t msq;
    uint32_t bins[NUM_FREQUENCY_HISTOGRAM_BINS] = {0};

    msq = (uint32_t)re[0] * re[0] + im[0] * im[0];
    bins[0] = msq;

    for (i = 1; i < FREQUENCY_FEATURE_WINDOW_SIZE / 2 + 1; ++i) {
        uint8_t ui = (i - 1) / FREQUENCY_HISTOGRAM_DIVIDER + 1;
        msq = (uint32_t)re[i] * re[i] + im[i] * im[i];
        bins[ui] += msq;
    }

    for (i = 0; i < NUM_FREQUENCY_HISTOGRAM_BINS; ++i) {
        OUTPUT_I(bins[i], result_i.v[axis]);
    }
    LOG("\n");
}

void spectral_feature_histogram_f(float re[], float im[], int axis)
{
    int i;
    float msq;
    float bins[NUM_FREQUENCY_HISTOGRAM_BINS] = {0};

    msq = re[0] * re[0] + im[0] * im[0];
    bins[0] = msq;

    for (i = 1; i < FREQUENCY_FEATURE_WINDOW_SIZE / 2 + 1; ++i) {
        uint8_t ui = (i - 1) / FREQUENCY_HISTOGRAM_DIVIDER + 1;
        msq = re[i] * re[i] + im[i] * im[i];
        bins[ui] += msq;
    }

    for (i = 0; i < NUM_FREQUENCY_HISTOGRAM_BINS; ++i) {
        OUTPUT_F(bins[i], result_f.v[axis]);
    }
    LOG("\n");
}

// ------------------------------------------

void feature_spectral_f(spectral_feature_function_f_t f, int axis)
{
    int i, j;
    float re[FREQUENCY_FEATURE_WINDOW_SIZE];
    float im[FREQUENCY_FEATURE_WINDOW_SIZE];

    LOG("axis=%d\n", axis);

    for (i = 0; i <= NSAMPLES - FREQUENCY_FEATURE_WINDOW_SIZE;
         i += PERIODIC_COMPUTATION_WINDOW_SIZE) {

        for (j = 0; j < FREQUENCY_FEATURE_WINDOW_SIZE; ++j) {
            re[j] = data[i + j].v[axis];
        }
        memset(im, 0, sizeof(im));

        // own FFT implementation
        fft(re, im, FREQUENCY_FEATURE_WINDOW_SIZE);
        f(re, im, axis);       
    }
}

void feature_spectral_i(spectral_feature_function_i_t f, int axis)
{
    int i, j;
    int16_t re[FREQUENCY_FEATURE_WINDOW_SIZE];
    int16_t im[FREQUENCY_FEATURE_WINDOW_SIZE];

    LOG("axis=%d\n", axis);

    for (i = 0; i <= NSAMPLES - FREQUENCY_FEATURE_WINDOW_SIZE;
         i += PERIODIC_COMPUTATION_WINDOW_SIZE) {

        for (j = 0; j < FREQUENCY_FEATURE_WINDOW_SIZE; ++j) {
            re[j] = data[i + j].v[axis];
        }
        memset(im, 0, sizeof(im));

        intfft(re, im, FREQUENCY_FEATURE_WINDOW_SIZE);

        f(re, im, axis);
    } 
}

// ------------------------------------------

void feature_spectral_maxima_i(void)
{
    feature_spectral_i(spectral_feature_maxima_i, 0);
    feature_spectral_i(spectral_feature_maxima_i, 1);
    feature_spectral_i(spectral_feature_maxima_i, 2);
}

// ------------------------------------------

void feature_spectral_maxima_f(void)
{
    feature_spectral_f(spectral_feature_maxima_f, 0);
    feature_spectral_f(spectral_feature_maxima_f, 1);
    feature_spectral_f(spectral_feature_maxima_f, 2);
}

// ------------------------------------------

void feature_spectral_density_i(void)
{
    feature_spectral_i(spectral_feature_density_i, 0);
    feature_spectral_i(spectral_feature_density_i, 1);
    feature_spectral_i(spectral_feature_density_i, 2);
}

// ------------------------------------------

void feature_spectral_density_f(void)
{
    feature_spectral_f(spectral_feature_density_f, 0);
    feature_spectral_f(spectral_feature_density_f, 1);
    feature_spectral_f(spectral_feature_density_f, 2);
}

// ------------------------------------------

void feature_spectral_centroid_f(void)
{
    feature_spectral_f(spectral_feature_centroid_f, 0);
    feature_spectral_f(spectral_feature_centroid_f, 1);
    feature_spectral_f(spectral_feature_centroid_f, 2);
}

// ------------------------------------------

void feature_spectral_flux_f_axis(int axis)
{
    int i, j;
    float re[FREQUENCY_FEATURE_WINDOW_SIZE];
    float im[FREQUENCY_FEATURE_WINDOW_SIZE];

    float re_old[FREQUENCY_FEATURE_WINDOW_SIZE];
    float im_old[FREQUENCY_FEATURE_WINDOW_SIZE];

    LOG("axis=%d\n", axis);

    for (i = 0; i <= NSAMPLES - FREQUENCY_FEATURE_WINDOW_SIZE;
         i += PERIODIC_COMPUTATION_WINDOW_SIZE) {

        for (j = 0; j < FREQUENCY_FEATURE_WINDOW_SIZE; ++j) {
            re[j] = data[i + j].v[axis];
        }
        memset(im, 0, sizeof(im));

        fft(re, im, FREQUENCY_FEATURE_WINDOW_SIZE);

        if(i > 0) {
            float sum = 0;
            for (j = 0; j < FREQUENCY_FEATURE_WINDOW_SIZE; ++j) {
                float x = re[j] - re_old[j];
                float y = im[j] - im_old[j];
                float m = x * x + y * y;
                sum += m;
            }
            OUTPUT_F(tsqrtf(sum), result_f.v[axis]);
            LOG("\n");
        }

        memcpy(im_old, im, sizeof(im));
        memcpy(re_old, re, sizeof(re));
    } 
}

void feature_spectral_flux_f(void)
{
    feature_spectral_flux_f_axis(0);
    feature_spectral_flux_f_axis(1);
    feature_spectral_flux_f_axis(2);
}

// ------------------------------------------

void feature_spectral_entropy_f(void)
{
    feature_spectral_f(spectral_feature_entropy_f, 0);
    feature_spectral_f(spectral_feature_entropy_f, 1);
    feature_spectral_f(spectral_feature_entropy_f, 2);
}

// ------------------------------------------

void feature_spectral_ma_f(void)
{
    int i, j;
    float re[FREQUENCY_FEATURE_WINDOW_SIZE][3];
    float im[FREQUENCY_FEATURE_WINDOW_SIZE][3];

    for (i = 0; i <= NSAMPLES - FREQUENCY_FEATURE_WINDOW_SIZE;
         i += PERIODIC_COMPUTATION_WINDOW_SIZE) {

        for (j = 0; j < FREQUENCY_FEATURE_WINDOW_SIZE; ++j) {
            re[j][0] = data[i + j].v[0];
            re[j][1] = data[i + j].v[1];
            re[j][2] = data[i + j].v[2];
        }
        memset(im, 0, sizeof(im));

        fft(re[0], im[0], FREQUENCY_FEATURE_WINDOW_SIZE);
        fft(re[1], im[1], FREQUENCY_FEATURE_WINDOW_SIZE);
        fft(re[2], im[2], FREQUENCY_FEATURE_WINDOW_SIZE);

        float sum = 0;
        for (j = 0; j <= FREQUENCY_FEATURE_WINDOW_SIZE / 2; ++j) {
            float amsq = re[j][0] * re[j][0] + im[j][0] * im[j][0];
            float bmsq = re[j][1] * re[j][1] + im[j][1] * im[j][1];
            float cmsq = re[j][2] * re[j][2] + im[j][2] * im[j][2];
            float msq = tsqrtf(amsq + bmsq + cmsq);
            if(j != 0 && j != FREQUENCY_FEATURE_WINDOW_SIZE / 2) {
                // account both for the negative and positive frequency
                sum += 2 * msq;
            } else {
                sum += msq;
            }
        }
        OUTPUT_F(sum, result_f.v[0]);
        LOG("\n");
    } 
}

// ------------------------------------------

void feature_spectral_ma_squared_i(void)
{
    int i, j;
    int16_t re[FREQUENCY_FEATURE_WINDOW_SIZE][3];
    int16_t im[FREQUENCY_FEATURE_WINDOW_SIZE][3];

    for (i = 0; i <= NSAMPLES - FREQUENCY_FEATURE_WINDOW_SIZE;
         i += PERIODIC_COMPUTATION_WINDOW_SIZE) {

        for (j = 0; j < FREQUENCY_FEATURE_WINDOW_SIZE; ++j) {
            re[j][0] = data[i + j].v[0];
            re[j][1] = data[i + j].v[1];
            re[j][2] = data[i + j].v[2];
        }
        memset(im, 0, sizeof(im));

        intfft(re[0], im[0], FREQUENCY_FEATURE_WINDOW_SIZE);
        intfft(re[1], im[1], FREQUENCY_FEATURE_WINDOW_SIZE);
        intfft(re[2], im[2], FREQUENCY_FEATURE_WINDOW_SIZE);

        uint64_t sum = 0;
        for (j = 0; j <= FREQUENCY_FEATURE_WINDOW_SIZE / 2; ++j) {
            // XXX: this could also be done using 32-bit arithmetic I guess?
            uint64_t amsq = (uint64_t)re[j][0] * re[j][0] + im[j][0] * im[j][0];
            uint64_t bmsq = (uint64_t)re[j][1] * re[j][1] + im[j][1] * im[j][1];
            uint64_t cmsq = (uint64_t)re[j][2] * re[j][2] + im[j][2] * im[j][2];
            uint64_t msq = amsq + bmsq + cmsq;
            if(j != 0 && j != FREQUENCY_FEATURE_WINDOW_SIZE / 2) {
                // account both for the negative and positive frequency
                sum += 2 * msq;
            } else {
                sum += msq;
            }
        }
        OUTPUT_IL((long long int)sum, result_i.v[0]);
        LOG("\n");
    } 
}

// ------------------------------------------

void feature_spectral_histogram_i(void)
{
    feature_spectral_i(spectral_feature_histogram_i, 0);
    feature_spectral_i(spectral_feature_histogram_i, 1);
    feature_spectral_i(spectral_feature_histogram_i, 2);
}

// ------------------------------------------

void feature_spectral_histogram_f(void)
{
    feature_spectral_f(spectral_feature_histogram_f, 0);
    feature_spectral_f(spectral_feature_histogram_f, 1);
    feature_spectral_f(spectral_feature_histogram_f, 2);
}

// ------------------------------------------
```

## src/features-time-advanced.c
```c
// ------------------------------------------

// The following must hold: #bins * divider == 256,
// where 256 is the number of possible accelerometer sample values.
#define NUM_TIME_HISTOGRAM_BINS 16
#define TIME_HISTOGRAM_DIVIDER  16

void feature_histogram_periodic_axis(int axis)
{
    int i, j;
    int bins[NUM_TIME_HISTOGRAM_BINS];
    LOG("axis=%d\n", axis);
    for (i = 0; i <= NSAMPLES - TIME_WINDOW_SIZE; i += PERIODIC_COMPUTATION_WINDOW_SIZE) {
        memset(bins, 0, sizeof(bins));
        for (j = 0; j < TIME_WINDOW_SIZE; ++j) {
            uint8_t ui = (uint8_t)data[i].v[axis] + 128;
            bins[ui / TIME_HISTOGRAM_DIVIDER]++;
        }
        for (j = 0; j < NUM_TIME_HISTOGRAM_BINS; ++j) {
            OUTPUT_I(bins[j], result_i.v[axis]);
        }
        LOG("\n");
    }
}

void feature_histogram_periodic(void)
{
    feature_histogram_periodic_axis(0);
    feature_histogram_periodic_axis(1);
    feature_histogram_periodic_axis(2);
}

// ------------------------------------------

//
// This is precomputed for window size 40 - don't use it with other sizes!
//
// The algorithm used to construct this:
//   int i;
//   const int ws = 40;
//   for(i = 1; i < ws; i++)  {
//     float p = (float)i / ws;
//     printf("%f,\n", -p * log2(p));
//   }
//
#if TIME_WINDOW_SIZE == 40
const float entropy_lookup_table[TIME_WINDOW_SIZE] = {
    0.000000,
    0.133048,
    0.216096,
    0.280272,
    0.332193,
    0.375000,
    0.410545,
    0.440050,
    0.464386,
    0.484201,
    0.500000,
    0.512187,
    0.521090,
    0.526984,
    0.530101,
    0.530639,
    0.528771,
    0.524648,
    0.518401,
    0.510150,
    0.500000,
    0.488046,
    0.474373,
    0.459061,
    0.442179,
    0.423795,
    0.403967,
    0.382752,
    0.360201,
    0.336362,
    0.311278,
    0.284992,
    0.257542,
    0.228966,
    0.199295,
    0.168564,
    0.136803,
    0.104039,
    0.070301,
    0.035613,
};
#elif TIME_WINDOW_SIZE == 32
const float entropy_lookup_table[TIME_WINDOW_SIZE] = {
    0.000000,
    0.156250,
    0.250000,
    0.320160,
    0.375000,
    0.418449,
    0.452820,
    0.479641,
    0.500000,
    0.514709,
    0.524397,
    0.529570,
    0.530639,
    0.527946,
    0.521782,
    0.512395,
    0.500000,
    0.484785,
    0.466917,
    0.446543,
    0.423795,
    0.398792,
    0.371641,
    0.342440,
    0.311278,
    0.278237,
    0.243393,
    0.206814,
    0.168564,
    0.128705,
    0.087290,
    0.044372,
};
#elif TIME_WINDOW_SIZE == 64
const float entropy_lookup_table[TIME_WINDOW_SIZE] = {
    0.000000,
    0.093750,
    0.156250,
    0.206955,
    0.250000,
    0.287349,
    0.320160,
    0.349196,
    0.375000,
    0.397979,
    0.418449,
    0.436660,
    0.452820,
    0.467098,
    0.479641,
    0.490573,
    0.500000,
    0.508018,
    0.514709,
    0.520147,
    0.524397,
    0.527521,
    0.529570,
    0.530595,
    0.530639,
    0.529744,
    0.527946,
    0.525282,
    0.521782,
    0.517477,
    0.512395,
    0.506561,
    0.500000,
    0.492734,
    0.484785,
    0.476173,
    0.466917,
    0.457035,
    0.446543,
    0.435458,
    0.423795,
    0.411568,
    0.398792,
    0.385478,
    0.371641,
    0.357291,
    0.342440,
    0.327099,
    0.311278,
    0.294988,
    0.278237,
    0.261036,
    0.243393,
    0.225316,
    0.206814,
    0.187894,
    0.168564,
    0.148832,
    0.128705,
    0.108188,
    0.087290,
    0.066016,
    0.044372,
    0.022365,
};
#elif TIME_WINDOW_SIZE == 128
const float entropy_lookup_table[TIME_WINDOW_SIZE] = {
    0.000000,
    0.054688,
    0.093750,
    0.126915,
    0.156250,
    0.182737,
    0.206955,
    0.229285,
    0.250000,
    0.269302,
    0.287349,
    0.304268,
    0.320160,
    0.335112,
    0.349196,
    0.362474,
    0.375000,
    0.386821,
    0.397979,
    0.408511,
    0.418449,
    0.427823,
    0.436660,
    0.444985,
    0.452820,
    0.460184,
    0.467098,
    0.473578,
    0.479641,
    0.485301,
    0.490573,
    0.495468,
    0.500000,
    0.504180,
    0.508018,
    0.511524,
    0.514709,
    0.517580,
    0.520147,
    0.522417,
    0.524397,
    0.526097,
    0.527521,
    0.528677,
    0.529570,
    0.530208,
    0.530595,
    0.530737,
    0.530639,
    0.530306,
    0.529744,
    0.528956,
    0.527946,
    0.526720,
    0.525282,
    0.523634,
    0.521782,
    0.519729,
    0.517477,
    0.515032,
    0.512395,
    0.509570,
    0.506561,
    0.503370,
    0.500000,
    0.496454,
    0.492734,
    0.488844,
    0.484785,
    0.480561,
    0.476173,
    0.471625,
    0.466917,
    0.462053,
    0.457035,
    0.451864,
    0.446543,
    0.441074,
    0.435458,
    0.429698,
    0.423795,
    0.417751,
    0.411568,
    0.405248,
    0.398792,
    0.392201,
    0.385478,
    0.378624,
    0.371641,
    0.364529,
    0.357291,
    0.349927,
    0.342440,
    0.334830,
    0.327099,
    0.319248,
    0.311278,
    0.303191,
    0.294988,
    0.286669,
    0.278237,
    0.269693,
    0.261036,
    0.252269,
    0.243393,
    0.234408,
    0.225316,
    0.216117,
    0.206814,
    0.197406,
    0.187894,
    0.178280,
    0.168564,
    0.158748,
    0.148832,
    0.138818,
    0.128705,
    0.118495,
    0.108188,
    0.097787,
    0.087290,
    0.076700,
    0.066016,
    0.055240,
    0.044372,
    0.033414,
    0.022365,
    0.011227,
};
#endif


static inline float calc_entropy(unsigned c)
{
    return entropy_lookup_table[c];
}

void feature_entropy_f_axis(int axis)
{
    int i;
    // this algo (ab)uses the fact that only 256 values are possible
    uint8_t stats[256] = {0};
    float entropy = 0.0;
    LOG("axis=%d\n", axis);
    for (i = 0; i < NSAMPLES; ++i) {
        int v1, v2;

        if (i < TIME_WINDOW_SIZE) {
            // lets just have 0 as the entropy of the first K elements for simplicity
            v1 = data[i].v[axis] + 128;
            stats[v1]++;
            LOG("0\n"); // just add padding zeroes at the start
            continue;
        }

        // remove a value
        v1 = data[i - TIME_WINDOW_SIZE].v[axis] + 128;
        v2 = data[i].v[axis] + 128;
        if (v1 == v2) {
            continue;
        }

        entropy -= calc_entropy(stats[v1]);
        stats[v1]--;
        if (stats[v1]) {
            entropy += calc_entropy(stats[v1]);
        }
    
        if (stats[v2]) {
            entropy -= calc_entropy(stats[v2]);
        }
        stats[v2]++;
        entropy += calc_entropy(stats[v2]);

        OUTPUT_F(entropy, result_f.v[axis]);
        LOG("\n");
    }
}

void feature_entropy_f(void)
{
    feature_entropy_f_axis(0);
    feature_entropy_f_axis(1);
    feature_entropy_f_axis(2);
}

// ------------------------------------------

void feature_entropy_periodic_f_axis(int axis)
{
    int i, j;
    LOG("axis=%d\n", axis);
    for (i = 0; i <= NSAMPLES - TIME_WINDOW_SIZE; i += PERIODIC_COMPUTATION_WINDOW_SIZE) {
        float entropy = 0.0;
        uint8_t stats[256] = {0};
        for (j = 0; j < TIME_WINDOW_SIZE; ++j) {
            int v = data[i + j].v[axis] + 128;
            stats[v]++;
        }

        for (j = 0; j < 256; ++j) {
            entropy += calc_entropy(stats[j]);
        }
        OUTPUT_F(entropy, result_f.v[axis]);
        LOG("\n");
    }
}

void feature_entropy_periodic_f(void)
{
    feature_entropy_periodic_f_axis(0);
    feature_entropy_periodic_f_axis(1);
    feature_entropy_periodic_f_axis(2);
}

// ------------------------------------------
```

## src/features-time-basic.c
```c
#include "qsort.h"

// -----------------------------------------------------------

void feature_mean_i_axis(int axis)
{
    int i;
    int32_t sum = 0;
    LOG("axis=%d\n", axis);
    for (i = 0; i < NSAMPLES; ++i) {
        if (i >= TIME_WINDOW_SIZE) {
            sum -= data[i - TIME_WINDOW_SIZE].v[axis];
        }
        sum += data[i].v[axis];

        OUTPUT_I(sum / TIME_WINDOW_SIZE, result_i.v[axis]);
        LOG("\n");
    }
}

void feature_mean_i(void)
{
    feature_mean_i_axis(0);
    feature_mean_i_axis(1);
    feature_mean_i_axis(2);
}

// -----------------------------------------------------------

void feature_mean_periodic_i_axis(int axis)
{
    int i, j;
    LOG("axis=%d\n", axis);
    for (i = 0; i <= NSAMPLES - TIME_WINDOW_SIZE; i += PERIODIC_COMPUTATION_WINDOW_SIZE) {
        int32_t sum = 0;
        for (j = 0; j < TIME_WINDOW_SIZE; ++j) {
            sum += data[i + j].v[axis];
        }
        
        OUTPUT_I(sum / TIME_WINDOW_SIZE, result_i.v[axis]);
        LOG("\n");
    }
}

void feature_mean_periodic_i(void)
{
    feature_mean_periodic_i_axis(0);
    feature_mean_periodic_i_axis(1);
    feature_mean_periodic_i_axis(2);
}

// -----------------------------------------------------------

void feature_mean_f_axis(int axis)
{
    int i;
    float sum = 0;
    LOG("axis=%d\n", axis);
    for (i = 0; i < NSAMPLES; ++i) {
        if (i >= TIME_WINDOW_SIZE) {
            sum -= data[i - TIME_WINDOW_SIZE].v[axis];
        }
        sum += data[i].v[axis];
        OUTPUT_F(sum / TIME_WINDOW_SIZE, result_f.v[axis]);
        LOG("\n");
    }
}

void feature_mean_f(void)
{
    feature_mean_f_axis(0);
    feature_mean_f_axis(1);
    feature_mean_f_axis(2);
}

// -----------------------------------------------------------

void feature_mean_periodic_f_axis(int axis)
{
    int i, j;
    LOG("axis=%d\n", axis);
    for (i = 0; i <= NSAMPLES - TIME_WINDOW_SIZE; i += PERIODIC_COMPUTATION_WINDOW_SIZE) {
        float sum = 0;
        for (j = 0; j < TIME_WINDOW_SIZE; ++j) {
            sum += data[i + j].v[axis];
        }

        OUTPUT_F(sum / TIME_WINDOW_SIZE, result_f.v[axis]);
        LOG("\n");
    }
}

void feature_mean_periodic_f(void)
{
    feature_mean_periodic_f_axis(0);
    feature_mean_periodic_f_axis(1);
    feature_mean_periodic_f_axis(2);
}

// -----------------------------------------------------------

void feature_magnitude_sq_i(void)
{
    int i;
    for (i = 0; i < NSAMPLES; ++i) {
        uint32_t m = (int32_t)data[i].v[0] * data[i].v[0]
                + data[i].v[1] * data[i].v[1]
                + data[i].v[2] * data[i].v[2];
        // note that this results in the squared magnitude!
        OUTPUT_I(m, result_i.v[0]);
        LOG("\n");
    }
}

// -----------------------------------------------------------

void feature_magnitude_f(void)
{
    int i;
    for (i = 0; i < NSAMPLES; ++i) {
        float r = (int32_t)data[i].v[0] * data[i].v[0]
                + data[i].v[1] * data[i].v[1]
                + data[i].v[2] * data[i].v[2];
#if 1
        OUTPUT_F(tsqrtf(r), result_f.v[0]);
#else
        // this requires linking with -lm
        OUTPUT_F(sqrtf(r), result_f.v[0]);
#endif
        LOG("\n");
    }
}

// -----------------------------------------------------------


void feature_min_axis(int axis)
{
    int i;
    int mn = INT_MAX;
    LOG("axis=%d\n", axis);
    for (i = 0; i < NSAMPLES; ++i) {
        mn = min(mn, data[i].v[axis]);

        OUTPUT_I(mn, result_i.v[axis]);
        LOG("\n");
    }
}

void feature_min(void)
{
    feature_min_axis(0);
    feature_min_axis(1);
    feature_min_axis(2);
}

// -----------------------------------------------------------

void feature_max_axis(int axis)
{
    int i;
    int mx = INT_MIN;
    LOG("axis=%d\n", axis);
    for (i = 0; i < NSAMPLES; ++i) {
        mx = max(mx, data[i].v[axis]);
        OUTPUT_I(mx, result_i.v[axis]);
        LOG("\n");
    }
}

void feature_max(void)
{
    feature_max_axis(0);
    feature_max_axis(1);
    feature_max_axis(2);
}

// -----------------------------------------------------------

void feature_min_periodic_axis(int axis)
{
    int i, j;
    LOG("axis=%d\n", axis);
    for (i = 0; i <= NSAMPLES - TIME_WINDOW_SIZE; i += PERIODIC_COMPUTATION_WINDOW_SIZE) {
        int mn = INT_MAX;
        for (j = 0; j < TIME_WINDOW_SIZE; ++j) {
            mn = min(mn, data[i + j].v[axis]);
        }
        
        OUTPUT_I(mn, result_i.v[axis]);
        LOG("\n");
    }
}

void feature_min_periodic(void)
{
    feature_min_periodic_axis(0);
    feature_min_periodic_axis(1);
    feature_min_periodic_axis(2);
}

// -----------------------------------------------------------

void feature_max_periodic_axis(int axis)
{
    int i, j;
    LOG("axis=%d\n", axis);
    for (i = 0; i <= NSAMPLES - TIME_WINDOW_SIZE; i += PERIODIC_COMPUTATION_WINDOW_SIZE) {
        int mx = INT_MIN;
        for (j = 0; j < TIME_WINDOW_SIZE; ++j) {
            mx = max(mx, data[i + j].v[axis]);
        }
        
        OUTPUT_I(mx, result_i.v[axis]);
        LOG("\n");
    }
}

void feature_max_periodic(void)
{
    feature_max_periodic_axis(0);
    feature_max_periodic_axis(1);
    feature_max_periodic_axis(2);
}

// -----------------------------------------------------------

void feature_variance_axis(int axis)
{
    int i;
    int32_t sum = 0;
    uint32_t squared_sum = 0;
    LOG("axis=%d\n", axis);
    for (i = 0; i < NSAMPLES; ++i) {
        if (i >= TIME_WINDOW_SIZE) {
            // remove a value
            int8_t v = data[i - TIME_WINDOW_SIZE].v[axis];
            sum -= v;
            squared_sum -= (int)v * v;
        }

        // add a value
        int8_t v = data[i].v[axis];
        sum += v;
        squared_sum += (int)v * v;

        int32_t avg = sum / TIME_WINDOW_SIZE;
        int32_t squared_avg = squared_sum / TIME_WINDOW_SIZE;

        OUTPUT_I(squared_avg - avg, result_i.v[axis]);
        LOG("\n");
    }
}

void feature_variance(void)
{
    feature_variance_axis(0);
    feature_variance_axis(1);
    feature_variance_axis(2);
}

// -----------------------------------------------------------

void feature_variance_periodic_axis(int axis)
{
    int i, j;
    LOG("axis=%d\n", axis);
    for (i = 0; i <= NSAMPLES - TIME_WINDOW_SIZE; i += PERIODIC_COMPUTATION_WINDOW_SIZE) {
        int32_t sum = 0;
        uint32_t squared_sum = 0;
        for (j = 0; j < TIME_WINDOW_SIZE; ++j) {
            int8_t v = data[i + j].v[axis];
            sum -= v;
            squared_sum -= (int)v * v;
        }

        int32_t avg = sum / TIME_WINDOW_SIZE;
        int32_t squared_avg = squared_sum / TIME_WINDOW_SIZE;

        OUTPUT_I(squared_avg - avg, result_i.v[axis]);
        LOG("\n");
    }
}

void feature_variance_periodic(void)
{
    feature_variance_periodic_axis(0);
    feature_variance_periodic_axis(1);
    feature_variance_periodic_axis(2);
}

// -----------------------------------------------------------

void feature_std_axis(int axis)
{
    int i;
    int32_t sum = 0;
    uint32_t squared_sum = 0;
    LOG("axis=%d\n", axis);
    for (i = 0; i < NSAMPLES; ++i) {
        if (i >= TIME_WINDOW_SIZE) {
            // remove a value
            int8_t v = data[i - TIME_WINDOW_SIZE].v[axis];
            sum -= v;
            squared_sum -= (int)v * v;
        }

        // add a value
        int8_t v = data[i].v[axis];
        sum += v;
        squared_sum += (int)v * v;

        int32_t avg = sum / TIME_WINDOW_SIZE;
        int32_t squared_avg = squared_sum / TIME_WINDOW_SIZE;
        OUTPUT_F(tsqrtf(squared_avg - avg * avg), result_f.v[axis]);
        LOG("\n");
    }
}

void feature_std(void)
{
    feature_std_axis(0);
    feature_std_axis(1);
    feature_std_axis(2);
}

// -----------------------------------------------------------

void feature_std_periodic_axis(int axis)
{
    int i, j;
    LOG("axis=%d\n", axis);
    for (i = 0; i <= NSAMPLES - TIME_WINDOW_SIZE; i += PERIODIC_COMPUTATION_WINDOW_SIZE) {
        int32_t sum = 0;
        uint32_t squared_sum = 0;
        for (j = 0; j < TIME_WINDOW_SIZE; ++j) {
            int8_t v = data[i + j].v[axis];
            sum += v;
            squared_sum += (int)v * v;
        }

        int32_t avg = sum / TIME_WINDOW_SIZE;
        int32_t squared_avg = squared_sum / TIME_WINDOW_SIZE;

        OUTPUT_F(tsqrtf(squared_avg - avg), result_f.v[axis]);
        LOG("\n");
    }
}

void feature_std_periodic(void)
{
    feature_std_periodic_axis(0);
    feature_std_periodic_axis(1);
    feature_std_periodic_axis(2);
}

// -----------------------------------------------------------

void feature_zero_crossings_axis(int axis)
{
    int i;
    int8_t old1 = data[0].v[axis];
    int8_t old2 = data[0].v[axis];
    unsigned num_crossings = 0;
    LOG("axis=%d\n", axis);
    for (i = 1; i < NSAMPLES; ++i) {
        if (i >= TIME_WINDOW_SIZE) {
            int index = i - TIME_WINDOW_SIZE;
            if ((data[index].v[axis] > 0 && old1 < 0)
                || (data[index].v[axis] < 0 && old1 > 0)) {
                num_crossings--;
                old1 = data[index].v[axis];
            }
        }

        if ((data[i].v[axis] > 0 && old2 < 0)
                || (data[i].v[axis] < 0 && old2 > 0)) {
            old2 = data[i].v[axis];
            num_crossings++;
        }

        OUTPUT_I(num_crossings, result_i.v[axis]);
        LOG("\n");
    }
}

void feature_zero_crossings(void)
{
    feature_zero_crossings_axis(0);
    feature_zero_crossings_axis(1);
    feature_zero_crossings_axis(2);
}

// -----------------------------------------------------------

void feature_zero_crossings_periodic_axis(int axis)
{
    int i, j;
    LOG("axis=%d\n", axis);
    for (i = 0; i <= NSAMPLES - TIME_WINDOW_SIZE;
         i += PERIODIC_COMPUTATION_WINDOW_SIZE) {
        int8_t old = data[i].v[axis];
        unsigned num_crossings = 0;
        for (j = 1; j < TIME_WINDOW_SIZE; ++j) {
            if ((data[i + j].v[axis] > 0 && old < 0)
                    || (data[i + j].v[axis] < 0 && old > 0)) {
                num_crossings++;
                old = data[i + j].v[axis];
            }
        }
        OUTPUT_I(num_crossings, result_i.v[axis]);
        LOG("\n");
    }
}

void feature_zero_crossings_periodic(void)
{
    feature_zero_crossings_periodic_axis(0);
    feature_zero_crossings_periodic_axis(1);
    feature_zero_crossings_periodic_axis(2);
}
 
// -----------------------------------------------------------
```

## src/fft.c
```c
#include "bitreverse.h"

#if FREQUENCY_FEATURE_WINDOW_SIZE == 256
#define FFT_NUM_BITS 8
#elif FREQUENCY_FEATURE_WINDOW_SIZE == 128
#define FFT_NUM_BITS 7
#elif FREQUENCY_FEATURE_WINDOW_SIZE == 64
#define FFT_NUM_BITS 6
#elif FREQUENCY_FEATURE_WINDOW_SIZE == 32
#define FFT_NUM_BITS 5
#else
#error Define FFT_NUM_BITS for your FFT window size!
#endif


#define FFT_TABLE_SIZE 256
#if FREQUENCY_FEATURE_WINDOW_SIZE > FFT_TABLE_SIZE
#error Only FFT up to 256 elements supported!
#endif

#define FFT_TABLE_BITS 8 // equal to log2(FFT_TABLE_SIZE)

//
// Lookup table of sine values from 0 to `pi`.
// Note: using symmetry, could optimize this to 1/2 times the size
//
const float sin_table[FFT_TABLE_SIZE] =
{
    0.000000, 0.012272, 0.024541, 0.036807, 0.049068, 0.061321, 0.073565, 0.085797,
    0.098017, 0.110222, 0.122411, 0.134581, 0.146730, 0.158858, 0.170962, 0.183040,
    0.195090, 0.207111, 0.219101, 0.231058, 0.242980, 0.254866, 0.266713, 0.278520,
    0.290285, 0.302006, 0.313682, 0.325310, 0.336890, 0.348419, 0.359895, 0.371317,
    0.382683, 0.393992, 0.405241, 0.416430, 0.427555, 0.438616, 0.449611, 0.460539,
    0.471397, 0.482184, 0.492898, 0.503538, 0.514103, 0.524590, 0.534998, 0.545325,
    0.555570, 0.565732, 0.575808, 0.585798, 0.595699, 0.605511, 0.615232, 0.624860,
    0.634393, 0.643832, 0.653173, 0.662416, 0.671559, 0.680601, 0.689541, 0.698376,
    0.707107, 0.715731, 0.724247, 0.732654, 0.740951, 0.749136, 0.757209, 0.765167,
    0.773010, 0.780737, 0.788346, 0.795837, 0.803208, 0.810457, 0.817585, 0.824589,
    0.831470, 0.838225, 0.844854, 0.851355, 0.857729, 0.863973, 0.870087, 0.876070,
    0.881921, 0.887640, 0.893224, 0.898674, 0.903989, 0.909168, 0.914210, 0.919114,
    0.923880, 0.928506, 0.932993, 0.937339, 0.941544, 0.945607, 0.949528, 0.953306,
    0.956940, 0.960431, 0.963776, 0.966976, 0.970031, 0.972940, 0.975702, 0.978317,
    0.980785, 0.983105, 0.985278, 0.987301, 0.989177, 0.990903, 0.992480, 0.993907,
    0.995185, 0.996313, 0.997290, 0.998118, 0.998795, 0.999322, 0.999699, 0.999925,
    1.000000, 0.999925, 0.999699, 0.999322, 0.998795, 0.998118, 0.997290, 0.996313,
    0.995185, 0.993907, 0.992480, 0.990903, 0.989177, 0.987301, 0.985278, 0.983105,
    0.980785, 0.978317, 0.975702, 0.972940, 0.970031, 0.966976, 0.963776, 0.960431,
    0.956940, 0.953306, 0.949528, 0.945607, 0.941544, 0.937339, 0.932993, 0.928506,
    0.923880, 0.919114, 0.914210, 0.909168, 0.903989, 0.898674, 0.893224, 0.887640,
    0.881921, 0.876070, 0.870087, 0.863973, 0.857729, 0.851355, 0.844854, 0.838225,
    0.831470, 0.824589, 0.817585, 0.810457, 0.803208, 0.795837, 0.788346, 0.780737,
    0.773010, 0.765167, 0.757209, 0.749136, 0.740951, 0.732654, 0.724247, 0.715731,
    0.707107, 0.698376, 0.689541, 0.680601, 0.671559, 0.662416, 0.653173, 0.643832,
    0.634393, 0.624859, 0.615232, 0.605511, 0.595699, 0.585798, 0.575808, 0.565732,
    0.555570, 0.545325, 0.534998, 0.524590, 0.514103, 0.503538, 0.492898, 0.482184,
    0.471397, 0.460539, 0.449611, 0.438616, 0.427555, 0.416429, 0.405241, 0.393992,
    0.382683, 0.371317, 0.359895, 0.348419, 0.336890, 0.325310, 0.313682, 0.302006,
    0.290285, 0.278520, 0.266713, 0.254866, 0.242980, 0.231058, 0.219101, 0.207111,
    0.195090, 0.183040, 0.170962, 0.158858, 0.146731, 0.134581, 0.122411, 0.110222,
    0.098017, 0.085797, 0.073564, 0.061321, 0.049068, 0.036807, 0.024541, 0.012271,
};

static inline float tsin(int i)
{
    return sin_table[i];
}

static inline float tcos(int i)
{
    if (i >= FFT_TABLE_SIZE / 2) {
        return -sin_table[i - FFT_TABLE_SIZE / 2];
    }
    return sin_table[i + FFT_TABLE_SIZE / 2];
}

//
// Recursive FFT implementation: the recursive subroutine
//
void fft_recursive(float xre[], float xim[], float yre[], float yim[], int step)
{
    int i;
    if (2 * step < FREQUENCY_FEATURE_WINDOW_SIZE) {
        fft_recursive(yre, yim, xre, xim, 2 * step);
        fft_recursive(yre + step, yim + step, xre + step, xim + step, 2 * step);
    }

    for (i = 0; i < FREQUENCY_FEATURE_WINDOW_SIZE; i += 2 * step) {
        float tre, tim;
        float ure, uim;
        float vre, vim;

        tre = tcos(i * (FFT_TABLE_SIZE / FREQUENCY_FEATURE_WINDOW_SIZE));
        tim = -tsin(i * (FFT_TABLE_SIZE / FREQUENCY_FEATURE_WINDOW_SIZE));

        ure = yre[i + step];
        uim = yim[i + step];

        vre = tre * ure - tim * uim;
        vim = tre * uim + tim * ure;

        xre[i / 2] = yre[i] + vre;
        xim[i / 2] = yim[i] + vim;

        xre[(i + FREQUENCY_FEATURE_WINDOW_SIZE) / 2] = yre[i] - vre;
        xim[(i + FREQUENCY_FEATURE_WINDOW_SIZE) / 2] = yim[i] - vim;
    }
}

//
// Recursive FFT implementation.
// Assumes n == FREQUENCY_FEATURE_WINDOW_SIZE
//
void fftr(float xre[], float xim[], int n)
{
    int i;
    float yre[FREQUENCY_FEATURE_WINDOW_SIZE], yim[FREQUENCY_FEATURE_WINDOW_SIZE];

    for (i = 0; i < FREQUENCY_FEATURE_WINDOW_SIZE; i++) {
        yre[i] = xre[i];
        yim[i] = xim[i];
    }

    fft_recursive(xre, xim, yre, yim, 1);
}

//
// Nonrecursive FFT implementation.
// assumes n == FREQUENCY_FEATURE_WINDOW_SIZE
//
void fft(float xre[], float xim[], int n)
{
    int i, shift;

    for (i = 0; i < FREQUENCY_FEATURE_WINDOW_SIZE; i++) {
        // swap the original and reversed values
        uint16_t irev = bitrev(i);

        if(i < irev) {
            float t;

            t = xre[i];
            xre[i] = xre[irev];
            xre[irev] = t;

            t = xim[i];
            xim[i] = xim[irev];
            xim[irev] = t;
        }
    }

    // go through all the matrix sizes from 2 to `N`
    for (shift = 0; (1 << shift) <= FREQUENCY_FEATURE_WINDOW_SIZE / 2; shift++) {
        int step = 1 << shift;
        int table_shift = FFT_TABLE_BITS - shift;
        int offset;

        // go through all the submatrix of size `step*2`
        for (offset = 0; offset < FREQUENCY_FEATURE_WINDOW_SIZE; offset += 2 * step) {

            // go through all the elements of the specific submatrix of size `step*2`
            for (i = 0; i < step; i++) {
                int index = i + offset;
                float tre, tim;
                float ure, uim;
                float wre, wim;

                wre = tcos(i << table_shift);
                wim = -tsin(i << table_shift);

                tre = wre * xre[index + step] - wim * xim[index + step];
                tim = wre * xim[index + step] + wim * xre[index + step];

                ure = xre[index];
                uim = xim[index];

                xre[index] = ure + tre;
                xim[index] = uim + tim;

                xre[index + step] = ure - tre;
                xim[index + step] = uim - tim;
            }
        }
    }
}
```
